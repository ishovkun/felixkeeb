/*
 * Copyright (c) 2020 The ZMK Contributors
 *
 * SPDX-License-Identifier: MIT
 */

#include "helix-layouts.dtsi"

/ {
    chosen {
        /delete-property/ zmk,matrix-transform;
        zmk,physical-layout = &helix_layout;
    };
};